## rk3506/buildroot/configs/rockchip_rk3506_luckfox_defconfig
```kconfig
#include "base/base.config"
#include "fs/vfat.config"
#include "lvgl/lvgl_rkadk.config"
#include "fs/ubifs.config"
BR2_ROOTFS_DEVICE_CREATION_DYNAMIC_DEVTMPFS=y
BR2_PACKAGE_EUDEV=n
BR2_PACKAGE_CAN_UTILS=y
BR2_PACKAGE_DIALOG=y
BR2_PACKAGE_DNSMASQ=n
BR2_PACKAGE_HOST_NTFS_3G=n
# Audio support is intentionally disabled; this board has no sound card.
BR2_PACKAGE_ALSA_LIB=n
BR2_PACKAGE_ALSA_PLUGINS=n
BR2_PACKAGE_ALSA_UCM_CONF=n
BR2_PACKAGE_ALSA_UTILS=n
BR2_PACKAGE_BLUEZ_ALSA=n
BR2_PACKAGE_BLUEZ5_UTILS_PLUGINS_AUDIO=n
BR2_PACKAGE_LIBMAD=n
BR2_PACKAGE_PULSEAUDIO=n
BR2_PACKAGE_RKWIFIBT_APP=n
BR2_PACKAGE_ROCKCHIP_ALSA_CONFIG=n
BR2_PACKAGE_SOX=n
BR2_PACKAGE_SPANDSP=n
BR2_PACKAGE_DTC=y
BR2_PACKAGE_DTC_PROGRAMS=y
BR2_PACKAGE_EVTEST=y
BR2_PACKAGE_FREETYPE=y
BR2_PACKAGE_FRECON=n
BR2_PACKAGE_FISH=y
BR2_PACKAGE_HOSTAPD=y
BR2_PACKAGE_HOSTAPD_EAP=y
BR2_PACKAGE_HOST_DTC=y
BR2_PACKAGE_HOST_LINUX_HEADERS_CUSTOM_6_1=y
BR2_PACKAGE_HTOP=y
BR2_PACKAGE_IPERF3=y
BR2_PACKAGE_IRQBALANCE=n
BR2_PACKAGE_IPROUTE2=y
BR2_PACKAGE_INPUT_EVENT_DAEMON=n
BR2_PACKAGE_LIBCAP=y
BR2_PACKAGE_LIBCURL=n
BR2_PACKAGE_LIBEVDEV=y
BR2_PACKAGE_LIBJPEG=y
BR2_PACKAGE_LIBOPENSSL_BIN=y
# BR2_PACKAGE_LVGL is reset to default
BR2_PACKAGE_MHZ=y
BR2_PACKAGE_MINICOM=n
BR2_PACKAGE_NANO=y
BR2_PACKAGE_NANOCOM=n
BR2_PACKAGE_NCURSES=y
BR2_PACKAGE_NCURSES_WCHAR=y
BR2_PACKAGE_OPENSSH=y
BR2_PACKAGE_OPENSSH_GEN_KEYS=y
BR2_PACKAGE_PCRE2_16=y
BR2_PACKAGE_PCRE2_32=y
BR2_PACKAGE_PHYTOOL=y
BR2_PACKAGE_PICOCOM=y
BR2_PACKAGE_PPPD=n
BR2_PACKAGE_PPPD_FILTER=n
# BR2_PACKAGE_PULSEAUDIO is reset to default
BR2_PACKAGE_PYTHON3=n
BR2_PACKAGE_PYTHON3_SSL=n
BR2_PACKAGE_PYTHON_AIOHTTP=n
BR2_PACKAGE_PYTHON_CANOPEN=n
BR2_PACKAGE_PYTHON_CLICK=n
BR2_PACKAGE_PYTHON_ITSDANGEROUS=n
BR2_PACKAGE_PYTHON_JINJA2=n
BR2_PACKAGE_PYTHON_PERIPHERY=n
BR2_PACKAGE_PYTHON_PILLOW=n
BR2_PACKAGE_PYTHON_SERIAL=n
BR2_PACKAGE_PYTHON_SETUPTOOLS=n
BR2_PACKAGE_PYTHON_SMBUS_CFFI=n
BR2_PACKAGE_PYTHON_SPIDEV=n
BR2_PACKAGE_PYTHON_WERKZEUG=n
BR2_PACKAGE_RIPGREP=y
BR2_PER_PACKAGE_DIRECTORIES=y
BR2_PACKAGE_RK3506=y
BR2_PACKAGE_RKADK=n
BR2_PACKAGE_ROCKIT=n
BR2_PACKAGE_RKADK_PLAYER=n
BR2_PACKAGE_ROCKCHIP_RGA=y
BR2_PACKAGE_ROCKCHIP_TEST=n
BR2_PACKAGE_UTIL_LINUX_AGETTY=y
# BR2_PACKAGE_USBMOUNT is not set
BR2_PACKAGE_VIM=y
BR2_PACK_EXTRA_TARGET=y
# BR2_PREFER_ROCKCHIP_RGA is not set
BR2_ROCKCHIP_ALSA_CONFIG_INSTALL_INIT_SCRIPT=n
BR2_TARGET_GENERIC_HOSTNAME="luckfox"
BR2_TARGET_GENERIC_ISSUE="Welcome to Luckfox Lyra [root:luckfox]"
BR2_ROOTFS_OVERLAY+=" /project/device/rootfs"
BR2_ROOTFS_POST_BUILD_SCRIPT+=" /project/device/rootfs/post-build.sh"
# BR2_TARGET_GENERIC_REMOUNT_ROOTFS_RW is not set
BR2_TARGET_GENERIC_ROOT_PASSWD="luckfox"
BR2_TARGET_ROOTFS_SQUASHFS4_LZ4=y
BR2_TARGET_ROOTFS_UBI_SQUASHFS=y
# BR2_TARGET_ROOTFS_UBI_SQUASHFS_STATIC is not set
BR2_TARGET_SERIAL_SHELL_GETTY=y
BR2_TIME_BITS_64=y
BR2_arm=y
BR2_cortex_a7=y
```

## rk3506/buildroot/package/fb-reset/Config.in
```kconfig
config BR2_PACKAGE_FB_RESET
	bool "fb-reset"
	help
	  Clear the legacy framebuffer and restore the active VT to text mode.
```

## rk3506/buildroot/package/fish/Config.in
```kconfig
config BR2_PACKAGE_FISH
	bool "fish"
	depends on BR2_USE_WCHAR
	select BR2_PACKAGE_NCURSES
	select BR2_PACKAGE_NCURSES_WCHAR
	select BR2_PACKAGE_PCRE2
	select BR2_PACKAGE_PCRE2_32
	help
	  Fish is a user-friendly command line shell.

	  This package uses fish 3.6, the last C++-based release, so it does
	  not require a Rust toolchain in the embedded Buildroot environment.

	  https://fishshell.com/

comment "fish needs a toolchain w/ wchar"
	depends on !BR2_USE_WCHAR
```

## rk3506/buildroot/package/obd2-dashboard/Config.in
```kconfig
config BR2_PACKAGE_OBD2_DASHBOARD
	bool "obd2-dashboard Slint application"
	depends on BR2_PACKAGE_HOST_RUSTC
	depends on BR2_PACKAGE_EUDEV
	select BR2_PACKAGE_LIBDRM
	select BR2_PACKAGE_LIBEVDEV
	select BR2_PACKAGE_LIBINPUT
	select BR2_PACKAGE_LIBXKBCOMMON
	select BR2_PACKAGE_FONTCONFIG
	help
	  OBD2 dashboard built with Slint's direct LinuxKMS software backend.
```

## rk3506/device/rockchip/.chips/rk3506/luckfox_lyra_zero-w_buildroot_spinand_defconfig
```kconfig
RK_BUILDROOT_BASE_CFG="rk3506_luckfox"
# RK_YOCTO is not set
RK_ROOTFS_SQUASHFS=y
RK_ROOTFS_OVERLAY=y
RK_ROOTFS_HOSTNAME_CUSTOM=y
RK_ROOTFS_HOSTNAME="luckfox"
RK_ROOTFS_INSTALL_MODULES=y
# Use kernel devtmpfs directly; this image has no udev-dependent userspace.
# BR2_ROOTFS_DEVICE_CREATION_DYNAMIC_EUDEV is not set
# BR2_PACKAGE_EUDEV is not set
# RK_ROOTFS_UDEV_RULES is not set
RK_WIFIBT_CHIP="AIC8800DC"
# RK_ROOTFS_LOG_GUARDIAN is not set
# RK_ROOTFS_FSTRIM is not set
RK_DISK_HELPERS_DISABLED=y
RK_EXTRA_FONTS_DISABLED=y
RK_UBOOT_CFG="rk3506_luckfox"
RK_UBOOT_CFG_FRAGMENTS="rk3506b_luckfox"
RK_UBOOT_SPL=y
RK_KERNEL_CFG="rk3506_luckfox_defconfig"
# RK_USB_ACM is not set
RK_USB_GADGET=y
RK_USB_ADBD=y
RK_USB_ADBD_SHELL="/usr/bin/fish"
RK_KERNEL_CFG_FRAGMENTS="rk3506-display.config rk3506-usb-serial.config rk3506-squashfs.config"
RK_KERNEL_DTS_NAME="rk3506b-luckfox-lyra-zero-w-co6300"
RK_BOOT_COMPRESSED=y
# RK_RECOVERY is not set
RK_EXTRA_PARTITION_NUM=0
RK_PARAMETER="parameter-lyra-spinand.txt"
RK_USE_FIT_IMG=y
# RK_NETWORK_CHECK is not set
```
